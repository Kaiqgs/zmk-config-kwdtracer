## boards/shields/kwdtracer/Kconfig.defconfig
```kconfig
if SHIELD_KWDTRACER_LEFT

config ZMK_KEYBOARD_NAME
	default "kwdtracer"

config ZMK_SPLIT_ROLE_CENTRAL
    default y

endif

if SHIELD_KWDTRACER_RIGHT

config ZMK_KEYBOARD_NAME
	default "kwdtracer_right"

endif

if SHIELD_KWDTRACER_LEFT || SHIELD_KWDTRACER_RIGHT

config ZMK_SPLIT
    default y

endif
```

## boards/shields/kwdtracer/Kconfig.shield
```kconfig
config SHIELD_KWDTRACER_LEFT
	def_bool $(shields_list_contains,kwdtracer_left)
    
config SHIELD_KWDTRACER_RIGHT
	def_bool $(shields_list_contains,kwdtracer_right)
```

## dts/bindings/zmk,travel-switch.yaml
```yaml
description: |
  Travel switch module with LED feedback and soft_off support.
  Listens for gpio-keys input events (INPUT_KEY_POWER) and controls
  an LED GPIO. Implements hold detection for entering/exiting soft_off.

compatible: "zmk,travel-switch"

properties:
  hold-time-ms:
    type: int
    default: 5000
    description: |
      Hold duration in milliseconds to trigger soft_off (when awake)
      or confirm wakeup (when waking from soft_off).

  led-timeout-ms:
    type: int
    default: 3000
    description: |
      Duration in milliseconds the LED stays on after a short press
      release (press shorter than hold-time-ms).

  blink-count:
    type: int
    default: 2
    description: Number of LED blinks on successful toggle.

  blink-interval-ms:
    type: int
    default: 500
    description: |
      Full blink cycle duration in milliseconds (one on phase + one off phase).
```

## modules/travel_switch/Kconfig
```kconfig
config TRAVEL_SWITCH
    bool "Travel switch with LED feedback and soft_off"
    default n
    depends on GPIO
```
